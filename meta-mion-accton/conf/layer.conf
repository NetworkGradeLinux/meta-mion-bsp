## meta-mion-accton/conf/layer.conf
```bitbake
# We have a conf and classes directory, add to BBPATH
BBPATH .= ":${LAYERDIR}"

# We have recipes-* directories, add to BBFILES
BBFILES += "${LAYERDIR}/recipes-*/*/*.bb \
            ${LAYERDIR}/recipes-*/*/*.bbappend"

BBFILE_COLLECTIONS += "meta-mion-accton"
BBFILE_PATTERN_meta-mion-accton = "^${LAYERDIR}/"
BBFILE_PRIORITY_meta-mion-accton = "6"

LAYERDEPENDS_meta-mion-accton = "core"
LAYERSERIES_COMPAT_meta-mion-accton = "dunfell"
```

## meta-mion-accton/conf/machine/accton-asgvolt64.conf
```bitbake
#@TYPE: Machine
#@NAME: accton-asgvolt64 

#@DESCRIPTION: Machine configuration for accton-asgvolt64 systems

require conf/platform-profiles/platform-accton.inc

PREFERRED_PROVIDER_virtual/kernel ?= "linux-yocto"
PREFERRED_VERSION_linux-yocto ?= "5.4%"

DEFAULTTUNE ?= "corei7-64"

require conf/machine/include/tune-corei7.inc
require conf/machine/include/x86-base.inc

MACHINE_FEATURES += "pcbios efi tpm2"
MACHINE_FEATURES_remove += "alsa"

SYSLINUX_OPTS = "serial 0 115200n8"
SERIAL_CONSOLE = "115200 ttyS0"
APPEND += "console=ttyS0,115200n8"

CONSOLE_SPEED = "115200"
CONSOLE_DEV = "0"
CONSOLE_PORT = "0x3f8"

GLIBC_ADDONS = "nptl"

ONIE_VENDOR="accton"

# Baseboard config, we don't load them as baseboard conf does the insmod
MACHINE_ESSENTIAL_EXTRA_RDEPENDS+="x86-64-accton-asgvolt64-cpld"
MACHINE_ESSENTIAL_EXTRA_RDEPENDS+="x86-64-accton-asgvolt64-fan"
MACHINE_ESSENTIAL_EXTRA_RDEPENDS+="x86-64-accton-asgvolt64-fpga"
MACHINE_ESSENTIAL_EXTRA_RDEPENDS+="x86-64-accton-asgvolt64-leds"
MACHINE_ESSENTIAL_EXTRA_RDEPENDS+="x86-64-accton-asgvolt64-psu"
MACHINE_ESSENTIAL_EXTRA_RDEPENDS+="x86-64-accton-asgvolt64-sys"
MACHINE_ESSENTIAL_EXTRA_RDEPENDS+="x86-64-accton-asgvolt64-thermal"
MACHINE_ESSENTIAL_EXTRA_RDEPENDS+="optoe"

MACHINEOVERRIDES =. "asgvolt64:"
```

## meta-mion-accton/conf/machine/accton-wedge100bf-32x.conf
```bitbake
#@TYPE: Machine
#@NAME: accton-wedge100bf-32x

#@DESCRIPTION: Machine configuration for accton-wedge100bf-32x systems

require conf/platform-profiles/platform-accton.inc

PREFERRED_PROVIDER_virtual/kernel ?= "linux-yocto"
PREFERRED_VERSION_linux-yocto ?= "5.4%"

DEFAULTTUNE ?= "corei7-64"

require conf/machine/include/tune-corei7.inc
require conf/machine/include/x86-base.inc

MACHINE_FEATURES += "pcbios efi tpm2"
MACHINE_FEATURES_remove += "alsa"

SYSLINUX_OPTS = "serial 0 57600n8"
SERIAL_CONSOLE = "57600 ttyS0"
APPEND += "console=ttyS0,57600n8"

CONSOLE_SPEED = "57600"
CONSOLE_DEV = "0"
CONSOLE_PORT = "0x3f8"

GLIBC_ADDONS = "nptl"

ONIE_VENDOR = "accton"

# Baseboard config, we don't load them as baseboard conf does the insmod
MACHINE_ESSENTIAL_EXTRA_RDEPENDS += "optoe"

MACHINEOVERRIDES =. "wedge100bf-32x:"
```

## meta-mion-delta/conf/layer.conf
```bitbake
# We have a conf and classes directory, add to BBPATH
BBPATH .= ":${LAYERDIR}"

# We have recipes-* directories, add to BBFILES
BBFILES += "${LAYERDIR}/recipes-*/*/*.bb \
            ${LAYERDIR}/recipes-*/*/*.bbappend"

BBFILE_COLLECTIONS += "meta-mion-delta"
BBFILE_PATTERN_meta-mion-delta = "^${LAYERDIR}/"
BBFILE_PRIORITY_meta-mion-delta = "6"

LAYERDEPENDS_meta-mion-delta = "core"
LAYERSERIES_COMPAT_meta-mion-delta = "dunfell"
```

## meta-mion-delta/conf/machine/delta-tn48m.conf
```bitbake
#@TYPE: Machine
#@NAME: delta-tn48m 

#@DESCRIPTION: Machine configuration for delta-tn48m systems

require conf/platform-profiles/platform-delta.inc

DEFAULTTUNE ?= "aarch64"

require conf/machine/include/arm/arch-armv8a.inc

TUNEVALID[aarch64] = "Enable instructions for aarch64"

MACHINEOVERRIDES .= "${@bb.utils.contains('TUNE_FEATURES', 'aarch64', ':aarch64', '' ,d)}"

# Little Endian base configs
AVAILTUNES += "aarch64 aarch64_be"
ARMPKGARCH_tune-aarch64 ?= "aarch64"
ARMPKGARCH_tune-aarch64_be ?= "aarch64_be"
TUNE_FEATURES_tune-aarch64 = "aarch64"
TUNE_FEATURES_tune-aarch64_be = "${TUNE_FEATURES_tune-aarch64} bigendian"
BASE_LIB_tune-aarch64 = "lib64"
BASE_LIB_tune-aarch64_be = "lib64"

PACKAGE_EXTRA_ARCHS_tune-aarch64 = "aarch64"
PACKAGE_EXTRA_ARCHS_tune-aarch64_be = "aarch64_be"

ARMPKGSFX_ENDIAN_64 = "${@bb.utils.contains('TUNE_FEATURES', 'bigendian', '_be', '', d)}"
TUNE_ARCH_64 = "aarch64${ARMPKGSFX_ENDIAN_64}"
TUNE_PKGARCH_64 = "aarch64${ARMPKGSFX_ENDIAN_64}"
ABIEXTENSION_64 = ""
TARGET_FPU_64 = ""

# Duplicated from marvell-arch-arm.inc
TUNE_ARCH_32 = "${@bb.utils.contains('TUNE_FEATURES', 'bigendian', 'armeb', 'arm', d)}"
TUNE_PKGARCH_32 = "${ARMPKGARCH}${ARMPKGSFX_THUMB}${ARMPKGSFX_DSP}${ARMPKGSFX_EABI}${ARMPKGSFX_ENDIAN}${ARMPKGSFX_FPU}"
ABIEXTENSION_32 = "eabi"
TARGET_FPU_32 = "${@d.getVar('TUNE_CCARGS_MFLOAT', True) or 'soft'}"

TUNE_ARCH = "${@bb.utils.contains('TUNE_FEATURES', 'aarch64', '${TUNE_ARCH_64}', '${TUNE_ARCH_32}' ,d)}"
TUNE_PKGARCH = "${@bb.utils.contains('TUNE_FEATURES', 'aarch64', '${TUNE_PKGARCH_64}', '${TUNE_PKGARCH_32}' ,d)}"
ABIEXTENSION = "${@bb.utils.contains('TUNE_FEATURES', 'aarch64', '${ABIEXTENSION_64}', '${ABIEXTENSION_32}' ,d)}"
TARGET_FPU = "${@bb.utils.contains('TUNE_FEATURES', 'aarch64', '${TARGET_FPU_64}', '${TARGET_FPU_32}' ,d)}"

PREFERRED_PROVIDER_virtual/kernel ?= "linux-yocto"
PREFERRED_VERSION_linux-yocto ?= "5.10%"

MACHINE_ENDIANNESS ?= "le"

DEFAULTTUNE_armada70xx ?= "${@bb.utils.contains("MACHINE_ENDIANNESS", "le", "aarch64", "aarch64_be", d)}"

MACHINEOVERRIDES =. "tn48m:"

#PREFERRED_PROVIDER_u-boot-script ??= "u-boot-script-marvell"

SERIAL_CONSOLE = "115200 ttyS0"

MACHINE_FEATURES = "ext2 ipsec nfs pci smbfs usbgadget usbhost vfat"

MACHINE_FEATURES_BACKFILL_CONSIDERED += "${@bb.utils.contains("MACHINE_ENDIANNESS", "be", "qemu-usermode", "", d)}"

KERNEL_DEVICETREE = " \
    marvell/delta-tn48m.dtb \
"

KERNEL_CLASSES += "kernel-fitimage"
KERNEL_IMAGETYPES = "Image fitImage"
KERNEL_IMAGETYPE = "Image"
INITRAMFS_MAXSIZE = "520000"
INITRAMFS_IMAGE_BUNDLE = "1"
INITRAMFS_IMAGE = "mion-onie-image-dent-initramfs"

UBOOT_ENTRYPOINT = "0x400000"
UBOOT_LOADADDRESS = "0x400000"

UBOOT_CONFIG = "armada-7040"

MACHINE_EXTRA_RRECOMMENDS = "kernel-modules"

EXTRA_IMAGEDEPENDS += "u-boot"

#IMAGE_INSTALL_append = " kernel-devicetree kernel-image-fitimage"

KERNEL_EXTRA_ARGS += "LOADADDR=${UBOOT_ENTRYPOINT}"

SERIAL_CONSOLES ?= "115200;ttyAMA0 115200;hvc0"
SERIAL_CONSOLES_CHECK = "${SERIAL_CONSOLES}"

GLIBC_ADDONS = "nptl"

ONIE_VENDOR="delta"

# Baseboard config, we don't load them as baseboard conf does the insmod
MACHINEOVERRIDES =. "delta-tn48m"

UBOOT_DEVICE_TREE = "armada-7040-db"

MACHINE_EXTRA_RRECOMMENDS += "kernel-modules"
```

## meta-mion-qemu/conf/layer.conf
```bitbake
# We have a conf and classes directory, add to BBPATH
BBPATH .= ":${LAYERDIR}"

# We have recipes-* directories, add to BBFILES
BBFILES += "${LAYERDIR}/recipes-*/*/*.bb \
            ${LAYERDIR}/recipes-*/*/*.bbappend"

BBFILE_COLLECTIONS += "meta-mion-qemu"
BBFILE_PATTERN_meta-mion-qemu = "^${LAYERDIR}/"
BBFILE_PRIORITY_meta-mion-qemu = "6"

LAYERDEPENDS_meta-mion-qemu = "core"
LAYERSERIES_COMPAT_meta-mion-qemu = "dunfell"
```

## meta-mion-qemu/conf/machine/qemu-qemux86-64.conf
```bitbake
#@TYPE: Machine
#@NAME: QEMU x86-64 Machine

#@DESCRIPTION: Machine configuration for running an x86_64 system on QEMU

require conf/machine/include/qemu.inc
require conf/platform-profiles/platform-qemu.inc

#KERNEL_IMAGETYPE = "zImage"
#SERIAL_CONSOLES ?= "115200;ttyAMA0 115200;ttyAMA1"

# Add the virtio RNG
#QB_OPT_APPEND = "-show-cursor -device virtio-rng-device"
# Virtio Networking support
#QB_TAP_OPT = "-netdev tap,id=net0,ifname=@TAP@,script=no,downscript=no"
#QB_SLIRP_OPT = "-netdev user,id=net0"
#QB_NETWORK_DEVICE = "-device virtio-net-device,netdev=net0,mac=@MAC@"

# Virtio serial console
#QB_SERIAL_OPT = "-device virtio-serial-device -chardev null,id=virtcon -device virtconsole,chardev=virtcon"
#QB_TCPSERIAL_OPT = "-device virtio-serial-device -chardev socket,id=virtcon,port=@PORT@,host=127.0.0.1 -device virtconsole,chardev=virtcon"

PREFERRED_PROVIDER_virtual/kernel ?= "linux-yocto"
PREFERRED_VERSION_linux-yocto ?= "5.4%"
MACHINE_FEATURES += "pcbios efi "
MACHINE_FEATURES_remove += "alsa"
GLIBC_ADDONS = "nptl"
ONIE_VENDOR= "qemu"

# Baseboard config, we don't load them as baseboard conf does the insmod
MACHINE_EXTRA_RDEPENDS+="optoe"
```

## meta-mion-skelton/conf/layer.conf
```bitbake
# We have a conf and classes directory, add to BBPATH
BBPATH .= ":${LAYERDIR}"

# We have recipes-* directories, add to BBFILES
BBFILES += "${LAYERDIR}/recipes-*/*/*.bb \
            ${LAYERDIR}/recipes-*/*/*.bbappend"

BBFILE_COLLECTIONS += "meta-mion-skeleton"
BBFILE_PATTERN_meta-mion-skeleton = "^${LAYERDIR}/"
BBFILE_PRIORITY_meta-mion-skeleton = "6"

LAYERDEPENDS_meta-mion-skeleton = "core"
LAYERSERIES_COMPAT_meta-mion-skeleton = "dunfell"
```

## meta-mion-skelton/conf/machine/skeleton-skelmachine.conf
```bitbake
#@TYPE: Machine
#@NAME: skeleton-skelmachine 

#@DESCRIPTION: Machine configuration for skeleton-skelmachine systems

require conf/platform-profiles/platform-skeleton.inc

PREFERRED_PROVIDER_virtual/kernel ?= "linux-yocto"
PREFERRED_VERSION_linux-yocto ?= "5.4%"

DEFAULTTUNE ?= "corei7-64"

require conf/machine/include/tune-corei7.inc
require conf/machine/include/x86-base.inc

MACHINE_FEATURES += "pcbios efi"
MACHINE_FEATURES_remove += "alsa"

SYSLINUX_OPTS = "serial 0 115200n8"
SERIAL_CONSOLE = "115200 ttyS0"
APPEND += "console=ttyS0,115200n8"

CONSOLE_SPEED = "115200"
CONSOLE_DEV = "0"
CONSOLE_PORT = "0x3f8"

GLIBC_ADDONS = "nptl"

ONIE_VENDOR="skeleton"

# Baseboard config, we don't load them as baseboard conf does the insmod
MACHINE_EXTRA_RDEPENDS+="x86-64-skeleton-skelmachine-cpld"
MACHINE_EXTRA_RDEPENDS+="optoe"

MACHINEOVERRIDES =. "skelmachine:"
```

## meta-mion-stordis/conf/layer.conf
```bitbake
# We have a conf and classes directory, add to BBPATH
BBPATH .= ":${LAYERDIR}"

# We have recipes-* directories, add to BBFILES
BBFILES += "${LAYERDIR}/recipes-*/*/*.bb \
            ${LAYERDIR}/recipes-*/*/*.bbappend"

BBFILE_COLLECTIONS += "meta-mion-stordis"
BBFILE_PATTERN_meta-mion-stordis = "^${LAYERDIR}/"
BBFILE_PRIORITY_meta-mion-stordis = "6"

LAYERDEPENDS_meta-mion-stordis = "core"
LAYERSERIES_COMPAT_meta-mion-stordis = "dunfell"
```

## meta-mion-stordis/conf/machine/stordis-bf2556x-1t.conf
```bitbake
#@TYPE: Machine
#@NAME: stordis-bf2556x-1t 

#@DESCRIPTION: Machine configuration for stordis-bf2556x-1t systems

require conf/platform-profiles/platform-stordis.inc

PREFERRED_PROVIDER_virtual/kernel ?= "linux-yocto"
PREFERRED_VERSION_linux-yocto ?= "5.4%"

DEFAULTTUNE ?= "corei7-64"

require conf/machine/include/tune-corei7.inc
require conf/machine/include/x86-base.inc

MACHINE_FEATURES += "pcbios efi"
MACHINE_FEATURES_remove += "alsa"

SYSLINUX_OPTS = "serial 0 115200n8"
SERIAL_CONSOLE = "115200 ttyS0"
APPEND += "console=ttyS0,115200n8"

CONSOLE_SPEED = "115200"
CONSOLE_DEV = "0"
CONSOLE_PORT = "0x3f8"

GLIBC_ADDONS = "nptl"

#MACHINE_EXTRA_RDEPENDS += "x86-64-stordis-bf2556x-1t-ir2_debug-1-mod"
MACHINE_EXTRA_RDEPENDS += "platform-stordis-bf2556x-1t"

ONIE_VENDOR="stordis"
MACHINEOVERRIDES =. "bf2556x:"
```

## meta-mion-stordis/conf/machine/stordis-bf6064x-t.conf
```bitbake
#@TYPE: Machine
#@NAME: stordis-bf6064x-t 

#@DESCRIPTION: Machine configuration for stordis-bf6064x-t systems

require conf/platform-profiles/platform-stordis.inc

PREFERRED_PROVIDER_virtual/kernel ?= "linux-yocto"
PREFERRED_VERSION_linux-yocto ?= "5.4%"

DEFAULTTUNE ?= "corei7-64"

require conf/machine/include/tune-corei7.inc
require conf/machine/include/x86-base.inc

MACHINE_FEATURES += "pcbios efi"
MACHINE_FEATURES_remove += "alsa"

SYSLINUX_OPTS = "serial 0 115200n8"
SERIAL_CONSOLE = "115200 ttyS0"
APPEND += "console=ttyS0,115200n8"

CONSOLE_SPEED = "115200"
CONSOLE_DEV = "0"
CONSOLE_PORT = "0x3f8"

GLIBC_ADDONS = "nptl"

#MACHINE_EXTRA_RDEPENDS += "x86-64-stordis-bf2556x-1t-ir2_debug-1-mod"
MACHINE_EXTRA_RDEPENDS += "platform-stordis-bf6064x-t"

ONIE_VENDOR="stordis"

# Baseboard config, we don't load them as baseboard conf does the insmod
MACHINE_EXTRA_RDEPENDS+="optoe"


MACHINEOVERRIDES =. "bf6064x:"
```
